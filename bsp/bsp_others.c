//=====================
//一些没有接口函数底层驱动封装
//主要是运行在后台
//=====================
#include "bsp_others.h"
#include "misc.h"
#include "rcc.h"
#include "address.h"
#include "adc.h"
#include "sys.h"
#include "delay.h"

//========================================
//10k 3950 NTC 热电阻分度表
//单位 欧*10000
//========================================
#if TEMPERATURE_TYPE == 2
static const int32_t tempTable3950_10K[][2] = {

{-40 ,3409281},		
{-39,	3188772},	
{-38,	2983978},	
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{105,	5821},

};
#endif


/*
易触的在用
这个值 = 欧*1000
*/
#if TEMPERATURE_TYPE == 1
static const int32_t tempTable3470_5K[][2] = {

{-40,	113110},
{-39,	105970},
{-38,	99500},
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{79,	810},
};
#endif

/*
金码温控头
这个值 = 欧*10000
Resistance	2.5k Ohms at 25deg. C 
B Value		470K at 25/50 deg. C 
*/
#if TEMPERATURE_TYPE == 0
static const int32_t tempTable3470_2_5K[][2] = {
	
{-40	,554979},
{-39	,523231},
{-38	,493515},
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{79	,4112},

};
#endif

//采用折半查找
int temp_chk(uint32_t res)
{
	const int32_t (*table)[2];//指向二维数组的指针
	uint16_t last, beg = 0,mid = 0, limit;
	
	#if TEMPERATURE_TYPE == 0
			last = sizeof(tempTable3470_2_5K)/8;
			res *= 10;//放大10倍,3470_2.5k 电阻单位是 k欧*10
			table = tempTable3470_2_5K;
	#endif
	
	#if TEMPERATURE_TYPE == 1
			last = sizeof(tempTable3470_5K)/8;
			table = tempTable3470_5K;
	#endif
	
	#if TEMPERATURE_TYPE == 2
			last = sizeof(tempTable3950_10K)/8;
			res *= 10;//放大10倍,3950_10k 电阻单位是 k欧*10
			table = tempTable3950_10K;
	#endif
	
//	switch(g_temperatureType)
//	{
//		case 2:
//			last = sizeof(tempTable3950_10K)/8;
//			res *= 10;//放大10倍,3950_10k 电阻单位是 k欧*10
//			table = tempTable3950_10K;
//		break;
//		case 1:
//			last = sizeof(tempTable3470_5K)/8;
//			table = tempTable3470_5K;
//		break;
//		case 0:
//			last = sizeof(tempTable3470_2_5K)/8;
//			res *= 10;//放大10倍,3470_2.5k 电阻单位是 k欧*10
//			table = tempTable3470_2_5K;
//		break;
//		default :
//			return 255;
//	}
	/*
	也可以人为限制有效温度范围（设置beg与last）
	*/
	limit = last;//做限制使用
   
	while(beg <= last)  
    {  
		mid = (beg + last) / 2;  
		if(mid >= limit) 
			return 255;
        if (res == table[mid][1] || (table[mid][1] > res && table[mid+1][1] < res)) 
        {  
			return table[mid][0]; 
        }  
        else 
		if (table[mid][1] > res)  
        {  
			beg = mid + 1;
        }  
        else 
		if (table[mid][1] < res)  
        {  
            last = mid - 1;
        }  
    }  
    return 255;  //表示错误，没有这个值
	
}
//========================================
//中断组配置
//说明：使用中断组1
//1位先占优先级，3位次优先级
//========================================
static void NVIC_group_config(void)
{
	//中断优先级分组
	NVIC_PriorityGroupConfig(NVIC_PriorityGroup_1);//2个先占优先级0，1；8个
}

//=======================================
//系统时钟初始化，库文件本身自带
//用户时钟初始化，用户可以自己修改
//中断分组初始化，选择系统所用的中断分组
//rtc时钟初始化
//地址配置初始化
//=======================================
void bsp_system_init(void)
{
	SystemInit();			//库文件定义
	user_rcc();				//用户自定义时钟
	NVIC_group_config();	//中断优先级分组
	addr_config();			//地址引脚初始化
}

//========================================
//地址查询
//========================================
void bsp_addr_check(void)
{
	uint8_t addr[4];
	get_board_addr(addr);
	sys_set_addr((addr[0] & 0x1) | ((addr[1] & 0x1) << 1) | ((addr[2] & 0x1) <<2 ) | ((addr[3] & 0x1) << 3));
	
}

uint16_t temp1,temp2,tempeture;
uint16_t tmp1[5],tmp2[5];
//========================================
//检测当前温度
//========================================
void  bsp_temp_check(void)
{	
	uint32_t i, value[2];
	uint32_t max, min;
	
	get_adc45_value(&tmp1[0], &tmp2[0]);
	delay_ms(50);
	get_adc45_value(&tmp1[1], &tmp2[1]);
	delay_ms(50);
	get_adc45_value(&tmp1[2], &tmp2[2]);
	delay_ms(50);
	get_adc45_value(&tmp1[3], &tmp2[3]);
	delay_ms(50);
	get_adc45_value(&tmp1[4], &tmp2[4]);
	
	for(i = 0; i < 5; i++)
	{
		if(i == 0)
		{
			max = tmp1[i];
			min = tmp1[i];
		}
		else
		{
			if(tmp1[i] >= max)
			{
				max = tmp1[i];
			}
			if(tmp1[i] <= min)
			{
				min = tmp1[i];
			}
		}
	}
	temp1 = (tmp1[0] + tmp1[1] + tmp1[2] + tmp1[3] + tmp1[4] - max - min) / 3;
	
//	for(i = 0; i < 5; i++)
//	{
//		if(tmp1[i%5] > tmp1[(i + 1)%5])
//		
//	}
	
	for(i = 0; i < 5; i++)
	{
		if(i == 0)
		{
			max = tmp2[i];
			min = tmp2[i];
		}
		else
		{
			if(tmp2[i] >= max)
			{
				max = tmp2[i];
			}
			if(tmp2[i] <= min)
			{
				min = tmp2[i];
			}
		}
	}
	temp2 = (tmp2[0] + tmp2[1] + tmp2[2] + tmp2[3] + tmp2[4] - max - min) / 3;
//	get_adc45_value(&temp1,&temp2);
//	temp1 = (temp1 + temp3)/2;
//	temp2 = (temp2 + temp4)/2;
	//计算温度值
	if(temp1 < 50)
	{
		value[0] = 0;
		temp_set_state(0,TEMP_STATE_NOINSTALL);
	}
	else
	{
		value[0] = 10000*4095/temp1-10000;//阻值
		if(tempeture != 0)
		{
			tempeture = (tempeture + temp_chk(value[0]))/2;
		}
		else
		{
			tempeture = temp_chk(value[0]);
		}
		temp_set_value(0, tempeture);
		temp_set_state(0, TEMP_STATE_NORMAL);

	}
	
	if(temp2 < 50)
	{	
		value[1] = 0;
		temp_set_state(1,TEMP_STATE_NOINSTALL);
	}
	else//未安装
	{
		value[1] = 10000*4095/temp2-10000;//
		temp_set_value(1, temp_chk(value[1]));
		temp_set_state(1, TEMP_STATE_NORMAL);
	}
	
	
	//这里也用回调函数处理得了
//	temp_set_value(0,temp_chk(value[0]));
//	temp_set_value(1,temp_chk(value[1]));
	
	
	//可以根据温度值来判断温度是否正常
	//一般认为小于 -10度 大于 70度，温度探头异常
	if(temp_get_value(0) < -10 || temp_get_value(0) > 70)
		temp_set_state(0,TEMP_STATE_ERR);
	if(temp_get_value(1) < -10 || temp_get_value(1) > 70)
		temp_set_state(1,TEMP_STATE_ERR);
	
}

